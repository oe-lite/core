## conf/distro/basic.conf
```bitbake
#@TYPE: Distribution
#@NAME: basic
#@DESCRIPTION: The most basic OE Lite distro

MACHINE_OS = "linux-gnu"

# crosstool-ng toolchain configuration
CT_KERNEL_VERSION		= "2.6.31.13"
CT_BINUTILS_VERSION		= "2.19.1"
CT_CC_VERSION			= "4.3.2"
CT_LIBC_VERSION			= "2.9"
CT_LIBC_GLIBC_MIN_KERNEL	= "2.6.31.13"
CT_GDB_VERSION			= "7.1"
CT_GMP_VERSION			= "4.3.1"
CT_MPFR_VERSION			= "2.4.2"
CT_PPL_VERSION			= "0.10.2"
CT_CLOOG_VERSION		= "0.15.9"
CT_MPC_VERSION			= "0.8.1"

# default crosstool-ng build configuration (to be overridden in
# site.conf or local.conf)
CT_PARALLEL_JOBS		= "12"
CT_LOAD				= "0"
```

## conf/distro/deif.conf
```bitbake
#@TYPE: Distribution
#@NAME: basic
#@DESCRIPTION: The most basic OE Lite distro

GCC_VERSION	= "4.3.2"
GLIBC_VERSION	= "2.9"

require conf/distro/lite.conf

INHERIT += "deif-mirror"
```

## conf/distro/linaro.conf
```bitbake
#@TYPE: Distribution
#@NAME: lite
#@DESCRIPTION: Simple OE-lite linaro distro

require conf/distro/core.conf

GCC_UPSTREAM_VERSION = "4.5"
GCC_LINARO_VERSION = "2011.10"

GDB_UPSTREAM_VERSION = "7.2"
GDB_LINARO_VERSION = "2011.05-0"

GCC_VERSION = "linaro-${GCC_UPSTREAM_VERSION}-${GCC_LINARO_VERSION}"
GDB_VERSION = "linaro-${GDB_UPSTREAM_VERSION}-${GDB_LINARO_VERSION}"

SRC_URI_GCC = "http://launchpad.net/gcc-linaro/${GCC_UPSTREAM_VERSION}/${GCC_UPSTREAM_VERSION}-${GCC_LINARO_VERSION}/+download/gcc-${GCC_VERSION}.tar.bz2;unpack=0"

DISTRO_USE_toolchain_gdb_version = "${GDB_VERSION}"
SRC_URI_GDB = "http://launchpad.net/gdb-linaro/${GDB_UPSTREAM_VERSION}/${GDB_UPSTREAM_VERSION}-${GDB_LINARO_VERSION}/+download/gdb-${GDB_VERSION}.tar.bz2;unpack=0"
```

## conf/distro/uclibc.conf
```bitbake
require common.inc

MACHINE_OS			= "linux-uclibc"
addhook uclinux_arch_fixup to post_conf_parse before early_overrides
def uclinux_arch_fixup(d):
    if d.get("MACHINE_CPU").startswith("m68k-mcf"):
        d.set("MACHINE_OS", "uclinux-uclibc")

DISTRO_USE_busybox_ash = "0"
DISTRO_USE_busybox_hush = "1"
```

## conf/layer.conf
```bitbake
PRIORITY_MAX			= "90"
PRIORITY_MIN			= "-9"
RECIPE_PREFERENCE_PRIORITY	= "2"
PACKAGE_PREFERENCE_PRIORITY	= "3"
```

## conf/machine/awc500pcm.conf
```bitbake
MACHINE_CPU	= "powerpc-e300c3"

# NAND flash
NAND_LEB_SIZE		= 131072
NAND_PEB_SIZE		= 131072
NAND_SUB_PAGE_SIZE	= 512
NAND_MIN_IO_SIZE	= 2048
NAND_MAX_LEB_CNT	= 1024
```
